## PS/apps/ad9361-tb/Config.in
```kconfig
config BR2_PACKAGE_AD9361
	bool "ad9361"
	depends on BR2_PACKAGE_LIBYAML
	default y
	help
	  AD9361 component
```

## PS/apps/capture-daemon-tb/Config.in
```kconfig
config BR2_PACKAGE_CAPTURE_DAEMON
	bool "capture-daemon"
	depends on BR2_PACKAGE_YAML_CPP
	default y
	help
	  CAPTURE-DAEMON component
```

## PS/apps/keysender-daemon-tb/Config.in
```kconfig
config BR2_PACKAGE_KEYSENDER_DAEMON
	bool "keysender-daemon"
	default y
	help
	  keysender-daemon component
```

## PS/apps/ks-daemon-tb/Config.in
```kconfig
config BR2_PACKAGE_KS_DAEMON
	bool "ks-daemon"
	default y
	help
	  keysender-daemon component
```

## PS/apps/modem-daemon-tb/Config.in
```kconfig
config BR2_PACKAGE_MODEM_DAEMON
	bool "modem-daemon"
	depends on BR2_PACKAGE_YAML_CPP
	default y
	help
	  MODEM-DAEMON component
```

## PS/apps/regparser-tb/Config.in
```kconfig
config BR2_PACKAGE_REGPARSER
	bool "regparser"
	default y
	help
	  regparser component
```

## PS/configs/ftp-config-tb/Config.in
```kconfig
config BR2_PACKAGE_FTP_CONFIG
	bool "ftp-config"
	default y
	help
	  PROFTPD configuration component
```

## PS/configs/network-config-tb/Config.in
```kconfig
config BR2_PACKAGE_NETWORK_CONFIG
	bool "network-config"
	default y
	help
	  network configuration component
```

## PS/configs/nw-configs-tb/Config.in
```kconfig
config BR2_PACKAGE_NW_CONFIGS
	bool "nw-configs"
	default y
	help
	  custom network application configs 
```

## PS/modules/mfhssdrv-tb/Config.in
```kconfig
config BR2_PACKAGE_MFHSSDRV
	bool "modem-fhss-module (custom mapped)"
	default y
	depends on BR2_LINUX_KERNEL
	help
	  Kernel module to support modem device.

comment "MODEM-FHSS module requires a linux kernel to be built"
	depends on !BR2_LINUX_KERNEL
```

## PS/modules/mfhssnet-tb/Config.in
```kconfig
config BR2_PACKAGE_MFHSSNET
	bool "modem-fhss network driver (custom mapped)"
	default y
	depends on BR2_LINUX_KERNEL
	help
	  Kernel module to support modem device.

comment "MODEM-FHSS module requires a linux kernel to be built"
	depends on !BR2_LINUX_KERNEL
```

## PS/modules/modem-capture-mod-tb/Config.in
```kconfig
config BR2_PACKAGE_MODEM_CAPTURE_MOD
	bool "modem-capture-module"
	default y
	depends on BR2_LINUX_KERNEL
	help
	  Kernel module to support anp device.

comment "MODEM_CAPTURE module requires a linux kernel to be built"
	depends on !BR2_LINUX_KERNEL
```

## PS/modules/modem-fhss-mod-tb/Config.in
```kconfig
config BR2_PACKAGE_MODEM_FHSS_MOD
	bool "modem-fhss-module"
	default y
	depends on BR2_LINUX_KERNEL
	help
	  Kernel module to support modem device.

comment "MODEM-FHSS module requires a linux kernel to be built"
	depends on !BR2_LINUX_KERNEL
```

## PS/scripts/network-scripts-tb/Config.in
```kconfig
config BR2_PACKAGE_NETWORK_SCRIPTS
	bool "network-scripts"
	default y
	help
	  NETWORK SCRIPTS component
```

## PS/scripts/startup-scripts-tb/Config.in
```kconfig
config BR2_PACKAGE_STARTUP
	bool "startup-scripts"
	default y
	help
	  STARTUP component
```

## PS/scripts/upgrade-fw-scripts-tb/Config.in
```kconfig
config BR2_PACKAGE_UPGRADE_FW
	bool "upgrade-fw"
	default y
	help
	  UPGRADE-FIRMWARE component
```
